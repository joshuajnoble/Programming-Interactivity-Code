#include <SdFat.h>

SdFat sd;
SdFile myFile;

const int READ_BUTTON = 3;
const int WRITE_BUTTON = 4;


void setup() {

  Serial.begin(57600);
  if (!sd.init(SPI_HALF_SPEED, chipSelect)) // half speed is better for breadboard
    sd.initErrorHalt();
    
  pinMode(READ_BUTTON, INPUT);  
  pinMode(WRITE_BUTTON, INPUT);
  
}

void loop() {

  if( digitalRead( WRITE_BUTTON )) {
     if (!myFile.open("buttonlogger.txt", O_RDWR | O_CREAT | O_AT_END)) {
      sd.errorHalt("opening buttonlogger.txt for write failed");
      return;
    }
    myFile.print(" tapped the button at ");
    myFile.print( millis() );
    myFile.print( " milliseconds since starting ");
    myFile.close(); // always close the file!
  }
  
  if(digitalRead( READ_BUTTON) ) {
     if (!myFile.open("buttonlogger.txt", O_RDWR | O_CREAT | O_AT_END)) {
        sd.errorHalt("opening buttonlogger.txt for write failed");
        return;
      }
      
      int data;
      while ((data = myFile.read()) > 0) {
        Serial.write(data);
      }
      myFile.close();
  }

}
