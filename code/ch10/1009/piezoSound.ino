int speakerOut = 3; // this is the pin that the piezo element should be connected to
// this enumerates the different notes
byte names[] = {'c', 'd', 'e', 'f', 'g', 'a', 'b', 'C'};
// enumerate the tones and the frequency required for them
int tones[] = {1915, 1700, 1519, 1432, 1275, 1136, 1014, 956};
// here's the melody we'll play, with the length of the note and the note itself
byte melody[] = "4c4d4e4f4g4a4b4C";
int eachNote = 0;
int noteLength = 0;
int findNote = 0;
int melodyLength = 8;
int theRightNote;

void setup() {
  pinMode(3, OUTPUT);
}

void loop() {
  //start our program
  digitalWrite(speakerOut, LOW);
  int correctedNoteLength;

  //loop through each notes in our melody
  for (eachNote = 0; eachNote < melodyLength; eachNote++) {
      // find the note that we're suppposed to play
      for (findNote=0;findNote<8;findNote++) {
        //store that note
        if (names[findNote] == melody[eachNote*2 + 1]) {
          theRightNote = findNote;
        }
      }

      // adjust the note because higher notes take less time to play
      // so we need to add some time to higher notes and subtract time
      // from lower notes
      int adjustmentAmt = (1450 - tones[theRightNote])*3;
      correctedNoteLength = (((melody[eachNote*2]) * 200) + adjustmentAmt) / 100;

      //make sure that we play the note for the length specified in the length
      for (noteLength = 0; noteLength <= correctedNoteLength; noteLength++) {
          digitalWrite(speakerOut,HIGH);
          delayMicroseconds(tones[theRightNote]);
          digitalWrite(speakerOut, LOW);
          delayMicroseconds(tones[theRightNote]);
      }
    }
  }
