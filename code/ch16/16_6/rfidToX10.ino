#include <x10.h>
#include <x10constants.h>
// RFID reader variables
#define TAG_LEN 12
#define RFID_START 2  // Parallax start is 10, ID12 is 2
#define RFID_STOP 3    // Parallax stop is 13, ID12 is 3
This is the value for the RFID tag that I’m using, but you’ll need to change it to the RFID tag that you have:
char tag[12] = { “0F03037185”};
char code[12];
int bytesread = 0;
int ledPin = 13; // Connect LED to pin 13
int rfidPin = 2; // RFID enable pin connected to digital pin 2
int val=0;
Now, add some variables for the X10 control:
int repeat = 1;
boolean lightsOn = false;

x10 house = x10(8, 9);

void setup() {
Serial.begin(2400);
    // X10 Module
    house.write(A, ALL_UNITS_OFF, repeat);
    pinMode(8,INPUT);
    pinMode(9,OUTPUT);
    pinMode(rfidPin,OUTPUT); // Set digital pin 2 as OUTPUT to connect it
                                // to the RFID /ENABLE pin
    pinMode(ledPin,OUTPUT); // Set ledPin to output
    digitalWrite(rfidPin, LOW); // Activate the RFID reader
}
void loop() {
if(Serial.available() > 0) {
        if((val = Serial.read()) == 2) {
            bytesread = 0;
            while(bytesread<10) {
                if( Serial.available() > 0) {
                    val = Serial.read();
                    if((val == RFID_START)||(val == RFID_STOP)) {
                        break;
                    }
                    code[bytesread] = val; // add the digit
                    bytesread++; // ready to read next digit
                }
            }

            if(bytesread >= 10)
            {
                Serial.flush(); // clear out the serial
                code(bytesread] = 0; // terminate the string
		if(strcmp(code, tag) == 0)
                {
                    if (lightsOn == false) {
                        house.write(A, UNIT_1, repeat);
                        house.write(A, ON, repeat);
                        lightsOn = true;
                    } else  {
                        house.write(A, UNIT_1, repeat);
                        house.write(A, OFF, repeat);
                        lightsOn = false;
                    }
                    Serial.flush();
                    delay(1000); // prevent readings from the same tag.
                } else {
                    Serial.flush();
                    delay(1000);
                    Serial.flush();
                }
            }

            bytesread = 0; // clear system and prepare for next cycle
            delay(500); // wait
       }
    }
}
