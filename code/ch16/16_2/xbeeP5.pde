import processing.core.*;
import processing.serial.*;
import xbee.XBeeDataFrame;
import xbee.XBeeReader;
Serial port;
    XBeeReader xbee;
    int[] analog;
    int[] digital;

    public void setup() {
        size(400, 400);
        port = new Serial(this, Serial.list()[0], 9600);
        xbee = new XBeeReader(this, port);
        xbee.startXBee();
        println("XBee Library version " + xbee.getVersion());
    }
    public void xBeeEvent(XBeeReader xbee) {
        println("Xbee Event!");
        XBeeDataFrame data = xbee.getXBeeReading();
        if (data.getApiID() == xbee.SERIES1_IOPACKET) {
            int totalSamples = data.getTotalSamples();
            for (int n = 0; n < totalSamples; n++) {
                print("Sample: " + n + "  ");
                // Current state of each digital channel
                   //(-1 indicates channel is not configured)
                digital = data.getDigital(n);
                // Current state of each analog channel
                  //(-1 indicates channel is not configured);
                analog = data.getAnalog(n);

                for (int i = 0; i < digital.length; i++) {
                    print(digital[i] + " ");
                }

                for (int i = 0; i < analog.length; i++) {
                    print(analog[i] + " ");
                }

            }
        } else {
            println("Not I/O data: " + data.getApiID());
        }
    }

    public void draw() {
        background(0);
        fill(255);
        for (int i = 0; i < digital.length; i++) {
           ellipse(50, i* 20, digital[i]);
        }
        for (int i = 0; i < analog.length; i++) {
           ellipse(250, i* 20, analog[i]);
        }
    }

public void keyPressed() {

    switch (key) {

    case '1':
        println(" Do node discovery and find any available nodes: ");
        xbee.nodeDiscover();
        break;
    case '2':
        println("Set the destination node of the XBees ");
        // this can be whatever you would like, just make sure that
        // there is a valid node first
        xbee.setDestinationNode("205");
        println();
        break;
    case '3':
        println("Get the Channel of the XBee using the CH command");
        xbee.getCH();
        break;
    case '4':
        println(" Send a datastring over the XBee ");
Here, the XBee will send a data string out using the address passed in. The two hexadecimal numbers that you see as the first two parameters are the high byte and low byte to send as the destination of the message. This way, an XBee can send a message with an address, and any other XBee can decide whether it wants to listen to the message. You can change these address values:
        xbee.sendDataString(0x0013A200, 0x403E17E6, "Bonjour!");
        break;
    case '5':
        println("Getting the high byte of the destination of the XBee");
        xbee.getDH();
        break;
    case '6':
        println("Getting the low byte of the destination of the XBee");
        xbee.getDL();
        break;
    case '7':
        println("Getting the ID of the XBee that sent data");
        xbee.getID();
        break;
    case '8':
        println("Get the Node Identifier using the NI command");
        xbee.getNI();
        break;
    case '9':
        xbee.setIOPin(1, 5);
        break;
    case '0':
        xbee.setIOPin(1, 4);
        break;
    case '-':
        println("get the address of the XBee that sent data ");
        xbee.sendRemoteCommand(0x0013A200, 0x403E17E5,0xFFFE,"MY",-1);
        break;
    }
}
