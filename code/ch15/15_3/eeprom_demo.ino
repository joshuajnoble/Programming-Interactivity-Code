#include <EEPROM.h>

#define TEST_MODE 1
#define DEMO_MODE 2
#define DISPLAY_MODE 3
// start reading from the first byte (address 0) of the EEPROM
int address = 0;
byte value;
byte incoming;
byte mode;

void setup() {
    Serial.begin(9600);
    mode = EEPROM.read(0);
}

void loop() {

    if(Serial.available() > 0 ) {
        incoming = Serial.read();
        boolean diffd = false;

        if(incoming == 1 && mode != TEST_MODE) {
            mode = TEST_MODE;
            diffd = true;
        }
        if(incoming == 2 && mode != DEMO_MODE) {
            mode = DEMO_MODE;
            diffd = true;
        }
        if(incoming == 3 && mode != DISPLAY_MODE) {
            mode = DISPLAY_MODE;
            diffd = true;
        }

        if(diffd) {
            EEPROM.write(0, mode);
        }

        // now do different things based on the mode

    }
}
